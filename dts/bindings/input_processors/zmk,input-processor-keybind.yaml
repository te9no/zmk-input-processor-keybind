## dts/bindings/input_processors/zmk,input-processor-keybind.yaml
```yaml
# Copyright (c) 2024, The ZMK Contributors
# SPDX-License-Identifier: MIT

description: Input Processor for key binding from relative input

compatible: "zmk,input-processor-keybind"

include: ip_zero_param.yaml

properties:
  "#input-processor-cells":
    type: int
    const: 0
  type:
    type: int
  track_remainders:
    type: boolean
    description: Track remaining movement
  bindings:
    description: "Behaviors to be invoked"
    type: phandle-array
    required: true
  tick:
    description: "Required ticks to trigger a ball action. Higher values require more movement to trigger a ball action. If omitted, 10 will be used."
    type: int
  wait-ms:
    description: "Time to wait (in milliseconds) before triggering the next behavior binding. If omitted, it will be set to 0."
    type: int
  tap-ms:
    description: "Time to wait (in milliseconds) between the press and release events on a triggered behavior binding. If omitted, it will be set to 0."
    type: int
  threshold:
    description: "Minimum movement delta required to trigger an activation. Must be a positive integer."
    type: int
  max_threshold:
    description: "Maximum allowed value for threshold. Used to cap sensitivity settings."
    type: int
  max_pending_activations:
    description: "Maximum number of pending activations that can be queued before ignoring further input(per axis)."
    type: int
```

## dts/bindings/input_processors/zmk-input-processor-keybind.yaml
```yaml
# Copyright (c) 2024, The ZMK Contributors
# SPDX-License-Identifier: MIT

description: Input Processor for key binding from relative input

compatible: "zmk,input-processor-keybind"

include: base.yaml

properties:
  "#input-processor-cells":
    type: int
    const: 0
    required: true
  bindings:
    description: "Behaviors to be invoked"
    type: phandle-array
    required: true
  type:
    type: int
  track-remainders:
    type: boolean
    description: Track remaining movement
    required: false
  tap-ms:
    type: int
    description: Tap duration in milliseconds
    default: 10
  wait-ms:
    type: int
    description: Wait duration in milliseconds
    default: 50
  tick:
    type: int
    description: Movement threshold
    default: 50
```

## src/pointing/Kconfig
```kconfig
config ZMK_INPUT_PROCESSOR_KEYBIND
    bool "Direction Keybind Input Processor"
    default n
    help
        Enable the direction keybind input processor.

        This input processor converts relative XY movements into direction key presses.

config ZMK_INPUT_PROCESSOR_KEYBIND_TAP_MS
    int "Tap Milliseconds"
    default 30
    depends on ZMK_INPUT_PROCESSOR_KEYBIND
    help
        The tap duration in milliseconds for the generated key presses.

config ZMK_INPUT_PROCESSOR_KEYBIND_WAIT_MS
    int "Wait Milliseconds"
    default 15
    depends on ZMK_INPUT_PROCESSOR_KEYBIND
    help
        The wait duration in milliseconds after the key press.

config ZMK_INPUT_PROCESSOR_KEYBIND_TICK
    int "Tick Threshold"
    default 10
    depends on ZMK_INPUT_PROCESSOR_KEYBIND
    help
        The movement threshold (in units) before a key press is triggered.
```
