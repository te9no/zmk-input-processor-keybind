/*
 * Copyright (c) 2024 The ZMK Contributors
 *
 * SPDX-License-Identifier: MIT
 */

/dts-v1/;

#include <dt-bindings/zmk/keys.h>
#include <dt-bindings/zmk/input-processor-keybind.h>

/ {
    zip_keybind_keys: zip_keybind_keys {
        compatible = "zmk,input-processor-keybind";
        #input-processor-cells = <0>;
        track_remainders;
        bindings = <&kp RIGHT>,
                  <&kp LEFT>,
                  <&kp UP>,
                  <&kp DOWN>;
        tick = <40>;
        wait-ms = <0>;
        tap-ms = <10>;
    };
};


